## software/nanoFramework/nf-native/target-overrides/defconfig
```kconfig
# defconfig for M0DMF_CUBLEY_F407 (static cubley-base)
CONFIG_RTOS_CHIBIOS=y
CONFIG_TARGET_BOARD="M0DMF_CUBLEY_F407"
CONFIG_TARGET_SERIES="STM32F4xx"
CONFIG_NF_FEATURE_DEBUGGER=y
CONFIG_NF_DEBUG_ASSERT=y
CONFIG_API_HARDWARE_STM32=y
CONFIG_API_SYSTEM_MATH=y
CONFIG_API_NANOFRAMEWORK_RUNTIME_EVENTS=y
CONFIG_API_SYSTEM_RUNTIME_SERIALIZATION=y
CONFIG_API_SYSTEM_DEVICE_GPIO=y
CONFIG_API_SYSTEM_DEVICE_I2C=y
# CONFIG_API_SYSTEM_DEVICE_SPI is not set
# CONFIG_API_SYSTEM_NET is not set
CONFIG_NF_FEATURE_HAS_CONFIG_BLOCK=y
CONFIG_NF_FEATURE_RTC=y
# CONFIG_NF_NETWORKING_SNTP is not set
# CONFIG_NF_SECURITY_MBEDTLS is not set
# CONFIG_NF_FEATURE_WATCHDOG is not set
```
